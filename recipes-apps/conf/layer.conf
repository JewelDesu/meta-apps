## recipes-apps/conf/layer.conf
```bitbake
# meta-apps/conf/layer.conf
# Basic layer configuration

BBPATH .= ":${LAYERDIR}"
BBFILES += "${LAYERDIR}/recipes-*/*/*.bb \
            ${LAYERDIR}/recipes-*/*/*.bbappend"

BBFILE_COLLECTIONS += "meta-apps"
BBFILE_PATTERN_meta-apps = "^${LAYERDIR}/"
BBFILE_PRIORITY_meta-apps = "6"

LAYERSERIES_COMPAT_meta-apps = "scarthgap"
```
